## CMakeLists.txt
```
# Copyright (C) 2026 Arm Limited
# SPDX-License-Identifier: Apache-2.0

cmake_minimum_required(VERSION 3.20.0)

find_package(Zephyr REQUIRED HINTS $ENV{ZEPHYR_BASE})
project(audiomark_zephyr C CXX)

set(AUDIOMARK_ROOT ${CMAKE_CURRENT_LIST_DIR}/../..)
set(AUDIOMARK_PORT_DIR ${AUDIOMARK_ROOT}/ports/arm)

set(AUDIOMARK_DEFAULT_MODEL_SOURCE
    ${AUDIOMARK_PORT_DIR}/ds_cnn_s_quantized.tflite.cpp)

if(CONFIG_BOARD_FVP_CORSTONE1000)
  set(AUDIOMARK_DEFAULT_MODEL_SOURCE
      ${AUDIOMARK_PORT_DIR}/ds_cnn_s_quantized_U85_256_vela.tflite.cpp)
elseif(CONFIG_BOARD_MPS4_CORSTONE320_FVP)
  set(AUDIOMARK_DEFAULT_MODEL_SOURCE
      ${AUDIOMARK_PORT_DIR}/ds_cnn_s_quantized_U85_256_vela.tflite.cpp)
endif()

set(AUDIOMARK_MODEL_SOURCE
    ${AUDIOMARK_DEFAULT_MODEL_SOURCE}
    CACHE FILEPATH "AudioMark DS-CNN TFLite model source to embed")

if(NOT IS_ABSOLUTE "${AUDIOMARK_MODEL_SOURCE}")
  get_filename_component(AUDIOMARK_MODEL_SOURCE "${AUDIOMARK_MODEL_SOURCE}"
                         ABSOLUTE BASE_DIR ${AUDIOMARK_ROOT})
endif()

if(NOT EXISTS "${AUDIOMARK_MODEL_SOURCE}")
  message(FATAL_ERROR "AUDIOMARK_MODEL_SOURCE does not exist: ${AUDIOMARK_MODEL_SOURCE}")
endif()

# Zephyr's CMSIS-DSP module can still be built with Neon through
# CONFIG_CMSIS_DSP_NEON. Keep AudioMark/Speex source-level overrides on the
# generic path: this Speex tree does not provide a complete Neon preprocessing
# path, and its fftwrap Neon calls expect a CMSIS-DSP RFFT scratch-argument API
# that Zephyr's CMSIS-DSP headers do not expose.
set(AUDIOMARK_DSP_ARCH_DEFS GENERIC_ARCH)

target_include_directories(app PRIVATE
  ${AUDIOMARK_ROOT}/src
  ${AUDIOMARK_ROOT}/lib/speexdsp
  ${AUDIOMARK_ROOT}/lib/speexdsp/include
  ${AUDIOMARK_ROOT}/lib/speexdsp/include/speex
  ${AUDIOMARK_ROOT}/lib/speexdsp/libspeexdsp
  ${AUDIOMARK_PORT_DIR}
  ${AUDIOMARK_PORT_DIR}/include
)

target_compile_definitions(app PRIVATE
  FLOATING_POINT
  EXPORT=
  ${AUDIOMARK_DSP_ARCH_DEFS}
  ARM_MATH_LOOPUNROLL
  REDUCED_FFT_TABSZ
  OVERRIDE_SPEEX_ALLOC
  OVERRIDE_FB_COMPUTE_BANK32
  OVERRIDE_FB_COMPUTE_PSD16
  OVERRIDE_ANR_VEC_MUL
  OVERRIDE_ANR_UPDATE_NOISE_ESTIMATE
  OVERRIDE_ANR_APOSTERIORI_SNR
  OVERRIDE_ANR_POWER_SPECTRUM
  OVERRIDE_ANR_COMPUTE_GAIN_FLOOR
  OVERRIDE_ANR_UPDATE_ZETA
  OVERRIDE_ANR_UPDATE_GAINS_CRITICAL_BANDS
  OVERRIDE_ANR_UPDATE_GAINS_LINEAR
  OVERRIDE_ANR_APPLY_SPEC_GAIN
  OVERRIDE_ANR_OLA
  OVERRIDE_ANR_UPDATE_NOISE_PROB
  OVERRIDE_MDF_DC_NOTCH
  OVERRIDE_MDF_INNER_PROD
  OVERRIDE_MDF_POWER_SPECTRUM
  OVERRIDE_MDF_POWER_SPECTRUM_ACCUM
  OVERRIDE_MDF_SPECTRAL_MUL_ACCUM
  OVERRIDE_MDF_WEIGHT_SPECT_MUL_CONJ
  OVERRIDE_MDF_ADJUST_PROP
  OVERRIDE_MDF_PREEMPH_FLT
  OVERRIDE_MDF_STRIDED_PREEMPH_FLT
  OVERRIDE_MDF_VEC_SUB
  OVERRIDE_MDF_VEC_SUB16
  OVERRIDE_MDF_VEC_ADD
  OVERRIDE_MDF_SMOOTHED_ADD
  OVERRIDE_MDF_DEEMPH
  OVERRIDE_MDF_SMOOTH_FE_NRG
  OVERRIDE_MDF_FILTERED_SPEC_AD_XCORR
  OVERRIDE_MDF_NORM_LEARN_RATE_CALC
  OVERRIDE_MDF_CONVERG_LEARN_RATE_CALC
  OVERRIDE_MDF_VEC_SCALE
  OS_SUPPORT_CUSTOM
  __RESTRICT=
  USE_CMSIS_DSP
  TF_INTERPRETER=1
  ACTIVATION_BUF_SZ=${CONFIG_AUDIOMARK_TENSOR_ARENA_SIZE}
)

set(AUDIOMARK_COMMON_KWS_SOURCES
  ${AUDIOMARK_ROOT}/src/ee_kws.c
  ${AUDIOMARK_ROOT}/src/ee_mfcc_f32.c
  ${AUDIOMARK_ROOT}/src/ee_mfcc_f32_tables.c
  ${AUDIOMARK_PORT_DIR}/th_api.c
  ${AUDIOMARK_PORT_DIR}/run_tflm_zephyr.cpp
  ${AUDIOMARK_MODEL_SOURCE}
)

set(AUDIOMARK_SPEEX_SOURCES
  ${AUDIOMARK_ROOT}/lib/speexdsp/libspeexdsp/buffer.c
  ${AUDIOMARK_ROOT}/lib/speexdsp/libspeexdsp/fftwrap.c
  ${AUDIOMARK_ROOT}/lib/speexdsp/libspeexdsp/filterbank.c
  ${AUDIOMARK_ROOT}/lib/speexdsp/libspeexdsp/jitter.c
  ${AUDIOMARK_ROOT}/lib/speexdsp/libspeexdsp/kiss_fft.c
  ${AUDIOMARK_ROOT}/lib/speexdsp/libspeexdsp/kiss_fftr.c
  ${AUDIOMARK_ROOT}/lib/speexdsp/libspeexdsp/mdf.c
  ${AUDIOMARK_ROOT}/lib/speexdsp/libspeexdsp/preprocess.c
  ${AUDIOMARK_ROOT}/lib/speexdsp/libspeexdsp/resample.c
  ${AUDIOMARK_ROOT}/lib/speexdsp/libspeexdsp/scal.c
  ${AUDIOMARK_ROOT}/lib/speexdsp/libspeexdsp/smallft.c
)

set(AUDIOMARK_COMMON_TEST_SOURCES
  src/test_main.c
  ${AUDIOMARK_PORT_DIR}/th_api.c
)

function(audiomark_add_unit_test TEST_SOURCE)
  set_source_files_properties(${TEST_SOURCE}
    PROPERTIES COMPILE_DEFINITIONS main=audiomark_test_main)
  target_sources(app PRIVATE
    ${AUDIOMARK_COMMON_TEST_SOURCES}
    ${TEST_SOURCE}
    ${ARGN}
  )
endfunction()

if(CONFIG_AUDIOMARK_TEST_KWS)
  audiomark_add_unit_test(${AUDIOMARK_ROOT}/tests/test_kws.c
    ${AUDIOMARK_ROOT}/src/ee_kws.c
    ${AUDIOMARK_ROOT}/src/ee_mfcc_f32.c
    ${AUDIOMARK_ROOT}/src/ee_mfcc_f32_tables.c
    ${AUDIOMARK_PORT_DIR}/run_tflm_zephyr.cpp
    ${AUDIOMARK_MODEL_SOURCE}
    ${AUDIOMARK_ROOT}/tests/data/kws_input.c
    ${AUDIOMARK_ROOT}/tests/data/kws_expected.c
  )
elseif(CONFIG_AUDIOMARK_TEST_MFCC)
  audiomark_add_unit_test(${AUDIOMARK_ROOT}/tests/test_mfcc_f32.c
    ${AUDIOMARK_ROOT}/src/ee_mfcc_f32.c
    ${AUDIOMARK_ROOT}/src/ee_mfcc_f32_tables.c
    ${AUDIOMARK_ROOT}/tests/data/mfcc_f32_all.c
  )
elseif(CONFIG_AUDIOMARK_TEST_AEC)
  audiomark_add_unit_test(${AUDIOMARK_ROOT}/tests/test_aec_f32.c
    ${AUDIOMARK_ROOT}/src/ee_aec_f32.c
    ${AUDIOMARK_SPEEX_SOURCES}
    ${AUDIOMARK_ROOT}/tests/data/aec_f32_input_source.c
    ${AUDIOMARK_ROOT}/tests/data/aec_f32_input_echo.c
    ${AUDIOMARK_ROOT}/tests/data/aec_f32_expected.c
  )
elseif(CONFIG_AUDIOMARK_TEST_ANR)
  audiomark_add_unit_test(${AUDIOMARK_ROOT}/tests/test_anr_f32.c
    ${AUDIOMARK_ROOT}/src/ee_anr_f32.c
    ${AUDIOMARK_SPEEX_SOURCES}
    ${AUDIOMARK_ROOT}/tests/data/anr_f32_input.c
    ${AUDIOMARK_ROOT}/tests/data/anr_f32_expected.c
  )
elseif(CONFIG_AUDIOMARK_TEST_ABF)
  audiomark_add_unit_test(${AUDIOMARK_ROOT}/tests/test_abf_f32.c
    ${AUDIOMARK_ROOT}/src/ee_abf_f32.c
    ${AUDIOMARK_ROOT}/src/ee_abf_f32_tables.c
    ${AUDIOMARK_ROOT}/tests/data/abf_f32_input_ch1.c
    ${AUDIOMARK_ROOT}/tests/data/abf_f32_input_ch2.c
    ${AUDIOMARK_ROOT}/tests/data/abf_f32_expected.c
  )
else()
  target_sources(app PRIVATE
    src/main.c

    ${AUDIOMARK_ROOT}/src/ee_audiomark.c
    ${AUDIOMARK_ROOT}/src/ee_aec_f32.c
    ${AUDIOMARK_ROOT}/src/ee_anr_f32.c
    ${AUDIOMARK_ROOT}/src/ee_abf_f32.c
    ${AUDIOMARK_ROOT}/src/ee_abf_f32_tables.c
    ${AUDIOMARK_COMMON_KWS_SOURCES}
    ${AUDIOMARK_SPEEX_SOURCES}
  )
endif()

target_link_libraries(app PRIVATE m)

zephyr_linker_sources_ifdef(CONFIG_SOC_SERIES_MPS4 SECTIONS linker.ld)
zephyr_linker_sources_ifdef(CONFIG_BOARD_FVP_CORSTONE1000 SECTIONS linker.ld)
```

## Kconfig
```
# Copyright (C) 2026 Arm Limited
# SPDX-License-Identifier: Apache-2.0

mainmenu "AudioMark Zephyr"

config AUDIOMARK_TENSOR_ARENA_SIZE
	int "TFLite Micro tensor arena size"
	default 2097152
	help
	  Tensor arena size used by the AudioMark DS-CNN TFLite Micro runner.
	  Increase this when using larger Vela outputs or additional fallback ops.

choice AUDIOMARK_APP_VARIANT
	prompt "AudioMark Zephyr application variant"
	default AUDIOMARK_APP_BENCHMARK

config AUDIOMARK_APP_BENCHMARK
	bool "Benchmark"
	select TENSORFLOW_LITE_MICRO
	select ETHOS_U
	help
	  Build the normal AudioMark benchmark runner.

config AUDIOMARK_TEST_KWS
	bool "KWS unit test"
	select TENSORFLOW_LITE_MICRO
	select ETHOS_U
	help
	  Build the keyword spotting unit test as a Zephyr application.

config AUDIOMARK_TEST_MFCC
	bool "MFCC unit test"
	help
	  Build the MFCC unit test as a Zephyr application.

config AUDIOMARK_TEST_AEC
	bool "AEC unit test"
	help
	  Build the acoustic echo cancellation unit test as a Zephyr application.

config AUDIOMARK_TEST_ANR
	bool "ANR unit test"
	help
	  Build the automatic noise reduction unit test as a Zephyr application.

config AUDIOMARK_TEST_ABF
	bool "ABF unit test"
	help
	  Build the adaptive beamforming unit test as a Zephyr application.

endchoice

source "Kconfig.zephyr"
```

## prj.conf
```kconfig
# AudioMark Zephyr default configuration.

CONFIG_CPP=y
CONFIG_STD_CPP17=y
CONFIG_REQUIRES_FULL_LIBC=y
CONFIG_REQUIRES_FULL_LIBCPP=y
CONFIG_REQUIRES_FLOAT_PRINTF=y

CONFIG_MAIN_STACK_SIZE=16384
CONFIG_HEAP_MEM_POOL_SIZE=65536
CONFIG_COMMON_LIBC_MALLOC_ARENA_SIZE=1048576

CONFIG_LOG=y

# AudioMark DSP path.
CONFIG_CMSIS_DSP=y
CONFIG_CMSIS_DSP_BASICMATH=y
CONFIG_CMSIS_DSP_COMPLEXMATH=y
CONFIG_CMSIS_DSP_FASTMATH=y
CONFIG_CMSIS_DSP_FILTERING=y
CONFIG_CMSIS_DSP_MATRIX=y
CONFIG_CMSIS_DSP_STATISTICS=y
CONFIG_CMSIS_DSP_SUPPORT=y
CONFIG_CMSIS_DSP_TRANSFORM=y
```

## boards/fvp_corstone1000_a320.conf
```kconfig
# Corstone-1000 / Cortex-A320 FVP.

CONFIG_MAIN_STACK_SIZE=32768
CONFIG_AUDIOMARK_TENSOR_ARENA_SIZE=2097152

# Keep AudioMark/Speex and Zephyr's CMSIS-DSP library on the Cortex-A Neon path.
CONFIG_CMSIS_DSP_NEON=y

# AudioMark + TFLM is larger than small default mappings on this platform.
CONFIG_KERNEL_VM_SIZE=0x2000000
CONFIG_MAX_XLAT_TABLES=16
```

## boards/mps4_corstone320_fvp.conf
```kconfig
# Corstone-320 / Cortex-M85 FVP.

CONFIG_FPU=y
CONFIG_FP_HARDABI=y
CONFIG_MAIN_STACK_SIZE=32768
CONFIG_AUDIOMARK_TENSOR_ARENA_SIZE=2097152

CONFIG_ETHOS_U85_256=y

# Keep available for non-delegated fallback ops on Cortex-M.
CONFIG_TENSORFLOW_LITE_MICRO_CMSIS_NN_KERNELS=y
```

## boards/fvp_corstone1000_a320.overlay
```dts
/*
 * Copyright (C) 2026 Arm Limited
 * SPDX-License-Identifier: Apache-2.0
 */

/* Board devicetree already exposes the Ethos-U85 instance. */
```

## boards/mps4_corstone320_fvp.overlay
```dts
/*
 * Copyright (C) 2026 Arm Limited
 * SPDX-License-Identifier: Apache-2.0
 */

&ethosu0 {
	#address-cells = <1>;
	#size-cells = <0>;

	/*
	 * Corstone-320 FVP timing adapters. Keep this aligned with the Vela
	 * system configuration used to produce the selected model.
	 */
	ta0: timing-adapter@50006000 {
		compatible = "arm,axi-timing-adapter";
		reg = <0x50006000>;
		status = "okay";

		version = <0x1117>;
		maxr = <8>;
		maxw = <8>;
		maxrw = <0>;
		rlatency = <32>;
		wlatency = <32>;
		pulse-on = <3999>;
		pulse-off = <1>;
		bwcap = <4000>;
		mode = <1>;
		perfctrl = <0>;
		perfcnt = <0>;
		histbin = <0>;
		histcnt = <0>;
	};

	ta1: timing-adapter@50006800 {
		compatible = "arm,axi-timing-adapter";
		reg = <0x50006800>;
		status = "okay";

		version = <0x1117>;
		maxr = <64>;
		maxw = <32>;
		maxrw = <0>;
		rlatency = <500>;
		wlatency = <250>;
		pulse-on = <4000>;
		pulse-off = <1000>;
		bwcap = <3750>;
		mode = <1>;
		perfctrl = <0>;
		perfcnt = <0>;
		histbin = <0>;
		histcnt = <0>;
	};
};
```

## src/main.c
```c
/**
 * Copyright (C) 2023 EEMBC
 * Copyright (C) 2026 Arm Limited
 *
 * All EEMBC Benchmark Software are products of EEMBC and are provided under the
 * terms of the EEMBC Benchmark License Agreements. The EEMBC Benchmark Software
 * are proprietary intellectual properties of EEMBC and its Members and is
 * protected under all applicable laws, including all applicable copyright laws.
 */

#include <stdbool.h>
#include <stdint.h>
#include <stdio.h>

#include <zephyr/kernel.h>

#include "ee_audiomark.h"

static uint64_t
th_microseconds(void)
{
    return k_cyc_to_us_floor64(k_cycle_get_64());
}

static bool
time_audiomark_run(uint32_t iterations, uint64_t *dt)
{
    uint64_t t0  = th_microseconds();
    bool     err = false;

    for (uint32_t i = 0; i < iterations; ++i)
    {
        if (ee_audiomark_run())
        {
            err = true;
            break;
        }
    }

    *dt = th_microseconds() - t0;
    return err;
}

int
main(void)
{
    bool     err        = false;
    uint32_t iterations = 1;
    uint64_t dt         = 0;

    printf("Initializing AudioMark\n");

    if (ee_audiomark_initialize())
    {
        printf("Failed to initialize AudioMark\n");
        return -1;
    }

    printf("Computing run speed\n");

    do
    {
        iterations *= 2;
        err = time_audiomark_run(iterations, &dt);
        if (err)
        {
            break;
        }
    } while (dt < 1000000ULL);

    if (err)
    {
        printf("Failed to compute iteration speed\n");
        goto exit;
    }

    float scale = 11000000.0f / (float)dt;
    iterations  = (uint32_t)((float)iterations * scale);
    iterations  = iterations < 10 ? 10 : iterations;

    printf("Measuring\n");

    err = time_audiomark_run(iterations, &dt);
    if (err)
    {
        printf("Failed main performance run\n");
        goto exit;
    }

    float sec   = (float)dt / 1000000.0f;
    float score = (float)iterations / sec * 1000.0f * (1.0f / 1.5f);

    printf("Total runtime    : %.3f seconds\n", (double)sec);
    printf("Total iterations : %u iterations\n", iterations);
    printf("Score            : %f AudioMarks\n", (double)score);

exit:
    ee_audiomark_release();
    return err ? -1 : 0;
}
```

## src/test_main.c
```c
/**
 * Copyright (C) 2023 EEMBC
 * Copyright (C) 2026 Arm Limited
 *
 * All EEMBC Benchmark Software are products of EEMBC and are provided under the
 * terms of the EEMBC Benchmark License Agreements. The EEMBC Benchmark Software
 * are proprietary intellectual properties of EEMBC and its Members and is
 * protected under all applicable laws, including all applicable copyright laws.
 */

#include <stdio.h>
#include <stdint.h>

#include <zephyr/device.h>
#include <zephyr/devicetree.h>
#include <zephyr/drivers/uart.h>
#include <zephyr/kernel.h>

int audiomark_test_main(int argc, char *argv[]);

#if defined(TF_INTERPRETER) && !defined(CONFIG_ETHOS_U)
int
cmsis_nn_init(void)
{
    return 0;
}

int
classify_on_cmsis_nn(const int8_t *in_data, int8_t *out_data)
{
    ARG_UNUSED(in_data);
    ARG_UNUSED(out_data);
    return -1;
}
#endif

static void
emit_eot(void)
{
    fflush(stdout);

#if DT_HAS_CHOSEN(zephyr_console)
    const struct device *uart = DEVICE_DT_GET(DT_CHOSEN(zephyr_console));

    if (device_is_ready(uart))
    {
        uart_poll_out(uart, 0x04);
        k_msleep(10);
        return;
    }
#endif

    printf("\x04");
    fflush(stdout);
    k_msleep(10);
}

int
main(void)
{
    int ret = audiomark_test_main(0, NULL);

    emit_eot();

    return ret;
}
```
